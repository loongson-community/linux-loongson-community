## arch/mips/loongson/Kconfig
```kconfig
choice
	prompt "Machine Type"
	depends on MACH_LOONGSON

config LEMOTE_FULOONG2E
	bool "Lemote Fuloong(2e) mini-PC"
	select ARCH_SPARSEMEM_ENABLE
	select CEVT_R4K
	select CSRC_R4K
	select SYS_HAS_CPU_LOONGSON2E
	select DMA_NONCOHERENT
	select BOOT_ELF32
	select BOARD_SCACHE
	select HW_HAS_PCI
	select I8259
	select ISA
	select IRQ_CPU
	select SYS_SUPPORTS_32BIT_KERNEL
	select SYS_SUPPORTS_64BIT_KERNEL
	select SYS_SUPPORTS_LITTLE_ENDIAN
	select SYS_SUPPORTS_HIGHMEM
	select SYS_HAS_EARLY_PRINTK
	select GENERIC_HARDIRQS_NO__DO_IRQ
	select GENERIC_ISA_DMA_SUPPORT_BROKEN
	select CPU_HAS_WB
	help
	  Lemote Fuloong(2e) mini-PC board based on the Chinese Loongson-2E CPU and
	  an FPGA northbridge

	  Lemote Fuloong(2e) mini PC have a VIA686B south bridge.

config LEMOTE_FULOONG2F
	bool "Lemote Fuloong(2f) mini-PC"
	select ARCH_SPARSEMEM_ENABLE
	select CEVT_R4K if !CS5536_MFGPT
	select CSRC_R4K if !CS5536_MFGPT
	select SYS_HAS_CPU_LOONGSON2F
	select DMA_NONCOHERENT
	select BOOT_ELF32
	select BOARD_SCACHE
	select HW_HAS_PCI
	select I8259
	select ISA
	select IRQ_CPU
	select SYS_SUPPORTS_32BIT_KERNEL
	select SYS_SUPPORTS_64BIT_KERNEL
	select SYS_SUPPORTS_LITTLE_ENDIAN
	select SYS_SUPPORTS_HIGHMEM
	select SYS_HAS_EARLY_PRINTK
	select GENERIC_HARDIRQS_NO__DO_IRQ
	select GENERIC_ISA_DMA_SUPPORT_BROKEN
	select CPU_HAS_WB
	select CS5536
	help
	  Lemote Fuloong(2f) mini-PC board based on the Chinese Loongson-2F
	  CPU, which has an internal DDR and PCIX controller. the PCIX
	  controller have the similiar programming interface of the FPGA north
	  bridge of LOONGSON2E.

	  Lemote Fuloong(2f) mini PC have an AMD CS5536 south bridge.

config LEMOTE_YEELOONG2F
	bool "Lemote Yeeloong(2f) mini Notebook"
	select ARCH_SPARSEMEM_ENABLE
	select CEVT_R4K if !CS5536_MFGPT
	select CSRC_R4K if !CS5536_MFGPT
	select SYS_HAS_CPU_LOONGSON2F
	select DMA_NONCOHERENT
	select BOOT_ELF32
	select BOARD_SCACHE
	select HW_HAS_PCI
	select I8259
	select ISA
	select IRQ_CPU
	select SYS_SUPPORTS_32BIT_KERNEL
	select SYS_SUPPORTS_64BIT_KERNEL
	select SYS_SUPPORTS_LITTLE_ENDIAN
	select SYS_SUPPORTS_HIGHMEM
	select SYS_HAS_EARLY_PRINTK
	select SYS_HAS_MACH_PROM_INIT_CMDLINE
	select GENERIC_HARDIRQS_NO__DO_IRQ
	select GENERIC_ISA_DMA_SUPPORT_BROKEN
	select CPU_HAS_WB
	select CS5536
	help
	  Lemote Laptop based on the Chinese Loongson-2F CPU, which has an
	  internal DDR and PCIX controller. the PCIX controller have the
	  similiar programming interface of the FPGA north bridge of
	  LOONGSON2E.

	  Lemote Yeeloong(2f) laptop have an AMD CS5536 south bridge and an EC
	  controller.
endchoice

config CS5536
	bool

config CS5536_FLASH
	bool
	depends on CS5536

config CS5536_NOR_FLASH
	bool
	depends on CS5536_FLASH

config CS5536_OTG
	bool
	depends on CS5536

config CS5536_UDC
	bool
	depends on CS5536

config CS5536_MFGPT
	bool "Using cs5536's MFGPT as system clock"
	depends on CS5536
	help
	  This is needed if cpufreq and oprofile is enabled in Loongson2(F)
	  machines

config UCA_SIZE
	hex "Uncache Accelerated Region size"
	depends on CPU_LOONGSON2F
	default 0x400000 if LEMOTE_YEELOONG2F
	default 0x2000000 if LEMOTE_FULOONG2F
	help
	  Uncached Acceleration(UCA) can greatly improve video performance.
	  Normally the Video memory can be accessed in Uncached Accelerated mode,
	  other peripheral spaces not.

	  Specify a zeroed size to disable this feature.

config SYS_HAS_MACH_PROM_INIT_CMDLINE
	bool

config LEMOTE_FL2FNAS
	bool "Lemote NAS(2F) machine"
	depends on LEMOTE_FULOONG2F
	help
	  Lemote's Loongson-2F based network attached system, The kernel
	  support to this machine is almost the same as fuloong2f, the only
	  difference is that it use the serial port provided by loongson2f
	  processor as yeeloong2f does.
```

## arch/mips/vr4181/Kconfig
```kconfig
config NEC_CMBVR4133
	bool "Support for NEC CMB-VR4133"
	depends on MACH_VR41XX
	select CPU_VR41XX
	select DMA_NONCOHERENT
	select IRQ_CPU
	select HW_HAS_PCI
	select PCI_VR41XX
	select SYS_SUPPORTS_32BIT_KERNEL
	select SYS_SUPPORTS_64BIT_KERNEL if EXPERIMENTAL

config ROCKHOPPER
	bool "Support for Rockhopper baseboard"
	depends on NEC_CMBVR4133
	select I8259
	select HAVE_STD_PC_SERIAL_PORT
	select SYS_SUPPORTS_32BIT_KERNEL
	select SYS_SUPPORTS_64BIT_KERNEL if EXPERIMENTAL

config CASIO_E55
	bool "Support for CASIO CASSIOPEIA E-10/15/55/65"
	depends on MACH_VR41XX
	select DMA_NONCOHERENT
	select IRQ_CPU
	select ISA
	select SYS_SUPPORTS_32BIT_KERNEL
	select SYS_SUPPORTS_64BIT_KERNEL if EXPERIMENTAL

config IBM_WORKPAD
	bool "Support for IBM WorkPad z50"
	depends on MACH_VR41XX
	select DMA_NONCOHERENT
	select IRQ_CPU
	select ISA
	select SYS_SUPPORTS_32BIT_KERNEL
	select SYS_SUPPORTS_64BIT_KERNEL if EXPERIMENTAL

config TANBAC_TB0226
	bool "Support for TANBAC TB0226 (Mbase)"
	depends on MACH_VR41XX
	select DMA_NONCOHERENT
	select HW_HAS_PCI
	select IRQ_CPU
	select SYS_SUPPORTS_32BIT_KERNEL
	select SYS_SUPPORTS_64BIT_KERNEL if EXPERIMENTAL
	help
	  The TANBAC TB0226 (Mbase) is a MIPS-based platform manufactured by
	  TANBAC.  Please refer to <http://www.tanbac.co.jp/> about Mbase.

config TANBAC_TB0229
	bool "Support for TANBAC TB0229 (VR4131DIMM)"
	depends on MACH_VR41XX
	select DMA_NONCOHERENT
	select HW_HAS_PCI
	select IRQ_CPU
	select SYS_SUPPORTS_32BIT_KERNEL
	select SYS_SUPPORTS_64BIT_KERNEL if EXPERIMENTAL
	help
	  The TANBAC TB0229 (VR4131DIMM) is a MIPS-based platform manufactured
	  by TANBAC.  Please refer to <http://www.tanbac.co.jp/> about
	  VR4131DIMM.

config TANBAC_TB0219
	bool "Added TANBAC TB0219 Base board support"
	depends on TANBAC_TB0229
	select SYS_SUPPORTS_32BIT_KERNEL
	select SYS_SUPPORTS_64BIT_KERNEL if EXPERIMENTAL
```

## arch/mips64/config.in
```kconfig
#
# For a description of the syntax of this configuration file,
# see Documentation/kbuild/config-language.txt.
#
define_bool CONFIG_MIPS y
define_bool CONFIG_MIPS64 y

mainmenu_name "Linux/MIPS64 Kernel Configuration"

source init/Config.in

mainmenu_option next_comment
comment 'Machine selection'
dep_bool 'Support for MIPS Atlas board (EXPERIMENTAL)' CONFIG_MIPS_ATLAS $CONFIG_EXPERIMENTAL
dep_bool 'Support for MIPS Malta board (EXPERIMENTAL)' CONFIG_MIPS_MALTA $CONFIG_EXPERIMENTAL
dep_bool 'Support for SGI-IP22 (Indy/Indigo2) (EXPERIMENTAL)' CONFIG_SGI_IP22 $CONFIG_EXPERIMENTAL
bool 'Support for SGI-IP27 (Origin200/2000)' CONFIG_SGI_IP27
if [ "$CONFIG_SGI_IP27" = "y" ]; then
   bool '  IP27 N-Mode' CONFIG_SGI_SN0_N_MODE
   bool '  Discontiguous Memory Support' CONFIG_DISCONTIGMEM
   bool '  NUMA support' CONFIG_NUMA
   bool '  Mapped kernel support' CONFIG_MAPPED_KERNEL
   bool '  Kernel text replication support' CONFIG_REPLICATE_KTEXT
   bool '  Exception handler replication support' CONFIG_REPLICATE_EXHANDLERS
   bool '  Multi-Processing support' CONFIG_SMP
   #bool '  IP27 XXL' CONFIG_SGI_SN0_XXL
fi
dep_bool 'Support for SGI-IP32 (O2) (EXPERIMENTAL)' CONFIG_SGI_IP32 $CONFIG_EXPERIMENTAL
bool 'Support for SiByte SB1250 SOC' CONFIG_SIBYTE_SB1250
if [ "$CONFIG_SIBYTE_SB1250" = "y" ]; then
   bool '  Support for SB1250 onchip PCI controller' CONFIG_PCI
   bool '  Support for SB1250 profiling - SB1/SCD perf counters' CONFIG_SIBYTE_SB1250_PROF
   bool '  Support for BCM1250 profiling using trace buffer' CONFIG_BCM1250_TBPROF
   bool '  Remote debugging (kgdb over UART 1)' CONFIG_REMOTE_DEBUG
   bool '  Support for SiByte SWARM board' CONFIG_SIBYTE_SWARM
   if [ "$CONFIG_SIBYTE_SWARM" = "y" ]; then
      bool '    Running under simulation' CONFIG_SIMULATION
      bool '    Configure for L3proc Demo' CONFIG_L3DEMO
      int '    Maximum memory chunks' CONFIG_SIBYTE_SWARM_MAX_MEM_REGIONS 16
      bool '    Multi-Processing support' CONFIG_SMP
   fi
fi

bool 'Preemptible Kernel' CONFIG_PREEMPT

define_bool CONFIG_RWSEM_GENERIC_SPINLOCK y
define_bool CONFIG_RWSEM_XCHGADD_ALGORITHM n

#
# Select some configuration options automatically based on user selections.
#

if [ "$CONFIG_MIPS_ATLAS" = "y" ]; then
   define_bool CONFIG_BOOT_ELF32 y
   define_int CONFIG_L1_CACHE_SHIFT 5
   define_bool CONFIG_NONCOHERENT_IO y
   define_bool CONFIG_PCI y
   define_bool CONFIG_SWAP_IO_SPACE y
fi
if [ "$CONFIG_MIPS_MALTA" = "y" ]; then
   define_bool CONFIG_BOOT_ELF32 y
   define_bool CONFIG_I8259 y
   define_int CONFIG_L1_CACHE_SHIFT 5
   define_bool CONFIG_NONCOHERENT_IO y
   define_bool CONFIG_PCI y
   define_bool CONFIG_SWAP_IO_SPACE y
fi
if [ "$CONFIG_SGI_IP22" = "y" ]; then
   define_bool CONFIG_ARC32 y
   define_bool CONFIG_ARC_CONSOLE y
   define_bool CONFIG_ARC_MEMORY y
   define_bool CONFIG_BOARD_SCACHE y
   define_bool CONFIG_IRQ_CPU y
   define_bool CONFIG_PC_KEYB y
   define_bool CONFIG_BOOT_ELF32 y
   define_bool CONFIG_NONCOHERENT_IO y
   define_bool CONFIG_SGI y
   define_int CONFIG_L1_CACHE_SHIFT 5
fi
if [ "$CONFIG_SGI_IP27" = "y" ]; then
   define_bool CONFIG_BOOT_ELF64 y
   define_bool CONFIG_ARC64 y
   define_bool CONFIG_MAPPED_PCI_IO y
   define_bool CONFIG_PCI y
   define_bool CONFIG_QL_ISP_A64 y
   define_int CONFIG_L1_CACHE_SHIFT 7
fi
if [ "$CONFIG_SGI_IP32" = "y" ]; then
   define_bool CONFIG_BOOT_ELF32 y
   define_bool CONFIG_ARC32 y
   define_bool CONFIG_PC_KEYB y
   define_bool CONFIG_PCI y
   #define_bool CONFIG_BOARD_SCACHE y
   define_bool CONFIG_MAPPED_PCI_IO y
   define_bool CONFIG_NONCOHERENT_IO y
   define_bool CONFIG_ARC_MEMORY y
   define_int CONFIG_L1_CACHE_SHIFT 5
fi
if [ "$CONFIG_SIBYTE_SWARM" = "y" ]; then
   define_bool CONFIG_BOOT_ELF32 y
   define_bool CONFIG_SWAP_IO_SPACE y
   define_bool CONFIG_CFE y
   define_bool CONFIG_SIBYTE_SB1250 y
   define_int CONFIG_L1_CACHE_SHIFT 5
fi
endmenu

mainmenu_option next_comment
comment 'CPU selection'

choice 'CPU type' \
	"R4300	CONFIG_CPU_R4300 \
	 R4x00	CONFIG_CPU_R4X00 \
	 R5000	CONFIG_CPU_R5000 \
	 R52x0	CONFIG_CPU_NEVADA \
	 R8000	CONFIG_CPU_R8000 \
	 R10000	CONFIG_CPU_R10000 \
	 SB1	CONFIG_CPU_SB1" R4x00
endmenu

define_bool CONFIG_CPU_HAS_LLSC y
define_bool CONFIG_CPU_HAS_LLDSCD y

mainmenu_option next_comment
comment 'General setup'

if [ "$CONFIG_CPU_R10000" = "y" ]; then
   bool 'Support for large 64-bit configurations' CONFIG_MIPS_INSANE_LARGE
fi
bool 'Generate little endian code' CONFIG_CPU_LITTLE_ENDIAN

if [ "$CONFIG_ARC32" = "y" ]; then
   bool 'ARC console support' CONFIG_ARC_CONSOLE
fi

if [ "$CONFIG_PCI" != "y" ]; then
   define_bool CONFIG_PCI n
fi

source drivers/pci/Config.in

if [ "$CONFIG_ISA" != "y" ]; then
   define_bool CONFIG_ISA n
   define_bool CONFIG_EISA n
else
   define_bool CONFIG_EISA y
fi

define_bool CONFIG_MCA n
define_bool CONFIG_SBUS n

bool 'Support for hot-pluggable devices' CONFIG_HOTPLUG

if [ "$CONFIG_HOTPLUG" = "y" ] ; then
   source drivers/pcmcia/Config.in
   source drivers/hotplug/Config.in
else
   define_bool CONFIG_PCMCIA n
   define_bool CONFIG_HOTPLUG_PCI n
fi

define_bool CONFIG_KCORE_ELF y
define_bool CONFIG_KCORE_AOUT n
tristate 'Kernel support for 64-bit ELF binaries' CONFIG_BINFMT_ELF
bool 'Kernel support for Linux/MIPS 32-bit binary compatibility' CONFIG_MIPS32_COMPAT
define_bool CONFIG_BINFMT_ELF32 $CONFIG_MIPS32_COMPAT
tristate 'Kernel support for MISC binaries' CONFIG_BINFMT_MISC
endmenu

source drivers/mtd/Config.in

source drivers/parport/Config.in

source drivers/pnp/Config.in

source drivers/block/Config.in

source drivers/md/Config.in

if [ "$CONFIG_NET" = "y" ]; then
   source net/Config.in
fi

source drivers/telephony/Config.in

if [ "$CONFIG_ISA" = "y" -o "$CONFIG_PCI" = "y" ]; then

   mainmenu_option next_comment
   comment 'ATA/IDE/MFM/RLL support'

   tristate 'ATA/IDE/MFM/RLL support' CONFIG_IDE

   if [ "$CONFIG_IDE" != "n" ]; then
      source drivers/ide/Config.in
   else
      define_bool CONFIG_BLK_DEV_IDE_MODES n
      define_bool CONFIG_BLK_DEV_HD n
   fi
   endmenu
fi

mainmenu_option next_comment
comment 'SCSI support'

tristate 'SCSI support' CONFIG_SCSI

if [ "$CONFIG_SCSI" != "n" ]; then
   source drivers/scsi/Config.in
fi
endmenu

if [ "$CONFIG_PCI" = "y" ]; then
   source drivers/message/i2o/Config.in
fi

if [ "$CONFIG_NET" = "y" ]; then
   mainmenu_option next_comment
   comment 'Network device support'

   bool 'Network device support' CONFIG_NETDEVICES
   if [ "$CONFIG_NETDEVICES" = "y" ]; then
      source drivers/net/Config.in
      if [ "$CONFIG_ATM" = "y" ]; then
	 source drivers/atm/Config.in
      fi
   fi
   endmenu
fi

source net/ax25/Config.in

source net/irda/Config.in

if [ "$CONFIG_NET" != "n" ]; then
   mainmenu_option next_comment
   comment 'ISDN subsystem'

   tristate 'ISDN support' CONFIG_ISDN
   if [ "$CONFIG_ISDN" != "n" ]; then
      source drivers/isdn/Config.in
   fi
   endmenu
fi

if [ "$CONFIG_ISA" = "y" ]; then
   mainmenu_option next_comment
   comment 'Old CD-ROM drivers (not SCSI, not IDE)'

   bool 'Support non-SCSI/IDE/ATAPI CDROM drives' CONFIG_CD_NO_IDESCSI
   if [ "$CONFIG_CD_NO_IDESCSI" != "n" ]; then
      source drivers/cdrom/Config.in
   fi
   endmenu
fi

source drivers/char/Config.in

#source drivers/misc/Config.in

source drivers/media/Config.in

if [ "$CONFIG_SGI_IP22" = "y" ]; then
   mainmenu_option next_comment
   comment 'SGI Character devices'
   if [ "$CONFIG_VT" = "y" ]; then
      tristate 'SGI Newport Console support' CONFIG_SGI_NEWPORT_CONSOLE
      if [ "$CONFIG_SGI_NEWPORT_CONSOLE" = "y" ]; then
	 define_bool CONFIG_FONT_8x16 y
      fi
      define_bool CONFIG_DUMMY_CONSOLE y
   fi
   endmenu
fi

source fs/Config.in

mainmenu_option next_comment
comment 'Sound'

tristate 'Sound card support' CONFIG_SOUND
if [ "$CONFIG_SOUND" != "n" ]; then
   source drivers/sound/Config.in
fi
endmenu

if [ "$CONFIG_SGI_IP22" = "y" ]; then
   source drivers/sgi/Config.in
fi

source drivers/usb/Config.in
source drivers/input/Config.in

mainmenu_option next_comment
comment 'Kernel hacking'

#bool 'Debug kmalloc/kfree' CONFIG_DEBUG_MALLOC
bool 'Are you using a crosscompiler' CONFIG_CROSSCOMPILE
bool 'Remote GDB kernel debugging' CONFIG_REMOTE_DEBUG
bool 'Magic SysRq key' CONFIG_MAGIC_SYSRQ
if [ "$CONFIG_SMP" != "y" ]; then
   bool 'Run uncached' CONFIG_MIPS_UNCACHED
fi
endmenu

source lib/Config.in
```

## drivers/platform/Kconfig
```kconfig
# drivers/platform/Kconfig

if X86
source "drivers/platform/x86/Kconfig"
endif

if MACH_LOONGSON
source "drivers/platform/loongson/Kconfig"
endif
```
