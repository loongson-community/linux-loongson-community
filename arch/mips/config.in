## drivers/platform/loongson/Kconfig
```kconfig
#
# Loongson Platform Specific Drivers
#

menuconfig LOONGSON_PLATFORM_DEVICES
	bool "Loongson Platform Specific Device Drivers"
	default y
	---help---
	  Say Y here to get to see options for device drivers for various
	  loongson platforms, including vendor-specific laptop extension drivers.
	  This option alone does not add any kernel code.

	  If you say N, all options in this submenu will be skipped and disabled.

if LOONGSON_PLATFORM_DEVICES

config LEMOTE_YEELOONG2F_PDEV
	tristate "Lemote YeeLoong Platform Specific Driver"
	depends on LEMOTE_YEELOONG2F
	default y
	select INPUT_EVDEV
	select HWMON
	select VIDEO_OUTPUT_CONTROL
	select THERMAL
	select BACKLIGHT_CLASS_DEVICE
	help
	  This is a driver for yeeloong laptops. It adds the yeeloong-specific
	  hwmon, hotkey, battery, backlight, video output and thermal cooling
	  device sub drivers.

	  This driver is orignally written by Liu junliang <liujl@lemote.com>
	  and maintained by huangwei <huangw@lemote.com> in this git
	  repository: http://dev.lemote.com/code/ec_module, but this driver is
	  almost rewritten totally by Wu Zhangjin <wuzhangjin@gmail.com> and Hu
	  Hongbing <huhb@lemote.com> to provide with standard interfaces.

config LEMOTE_YEELOONG2F_PDEV_ROM
	tristate "Lemote YeeLoong PMON & EC accessing support"
	depends on LEMOTE_YEELOONG2F && MTD && MTD_PARTITIONS
	default n
	help
	  This driver add the ROM of PMON & EC accessing(dump/flush) support.
	  It's very dangerous to flush the ROM of PMON & EC, so please NOT do it!

config LEMOTE_LYNLOONG2F_PDEV
	tristate "Lemote LynLoong(Allinone) Platform Specific Driver"
	depends on LEMOTE_LYNLOONG2F
	select THERMAL
	default y
	help
	  This is a driver for lynloong machine, It adds the lynloong-specific
	  backlight driver and the lynloong platform driver.

endif # LOONGSON_PLATFORM_DEVICES
```

## drivers/platform/mips/Kconfig
```kconfig
#
# MIPS Platform Specific Drivers
#

menuconfig MIPS_PLATFORM_DEVICES
	bool "MIPS Platform Specific Device Drivers"
	default y
	help
	  Say Y here to get to see options for device drivers of various
	  MIPS platforms, including vendor-specific netbook/laptop/desktop
	  extension and hardware monitor drivers. This option itself does
	  not add any kernel code.

	  If you say N, all options in this submenu will be skipped and disabled.

if MIPS_PLATFORM_DEVICES

config LEMOTE_YEELOONG2F
	tristate "Lemote YeeLoong Laptop"
	depends on LEMOTE_MACH2F
	select BACKLIGHT_LCD_SUPPORT
	select LCD_CLASS_DEVICE
	select BACKLIGHT_CLASS_DEVICE
	select POWER_SUPPLY
	select HWMON
	select VIDEO_OUTPUT_CONTROL
	select INPUT_SPARSEKMAP
	select INPUT_EVDEV
	depends on INPUT
	default m
	help
	  YeeLoong netbook is a mini laptop made by Lemote, which is basically
	  compatible to FuLoong2F mini PC, but it has an extra Embedded
	  Controller(kb3310b) for battery, hotkey, backlight, temperature and
	  fan management.

config LEMOTE_LYNLOONG2F
	tristate "Lemote LynLoong PC"
	depends on LEMOTE_MACH2F
	select BACKLIGHT_LCD_SUPPORT
	select BACKLIGHT_CLASS_DEVICE
	select VIDEO_OUTPUT_CONTROL
	default m
	help
	  LynLoong PC is an AllINONE machine made by Lemote, which is basically
	  compatible to FuLoong2F Mini PC, the only difference is that it has a
	  size-fixed screen: 1360x768 with sisfb video driver. and also, it has
	  its own specific suspend support.

config GDIUM_LAPTOP
	tristate "GDIUM laptop extras"
	depends on DEXXON_GDIUM
	select POWER_SUPPLY
	select I2C
	select INPUT_POLLDEV
	default m
	help
	  This mini-driver drives the ST7 chipset present in the Gdium laptops.
	  This gives battery support, wlan rfkill.

config MIPS_ACPI
	bool
	default y if LOONGSON_MACH3X

config CPU_HWMON
	tristate "Loongson CPU HWMon Driver"
	depends on LOONGSON_MACH3X
	select HWMON
	default y
	help
	  Loongson-3A/3B CPU Hwmon (temperature sensor) driver.

endif # MIPS_PLATFORM_DEVICES
```

## drivers/sgi/Kconfig
```kconfig
#
# Character device configuration
#

menu "SGI devices"
	depends on SGI_IP22

config SGI_DS1286
	bool "SGI DS1286  RTC support"
	help
	  If you say Y here and create a character special file /dev/rtc with
	  major number 10 and minor number 135 using mknod ("man mknod"), you
	  will get access to the real time clock built into your computer.
	  Every SGI has such a clock built in. It reports status information
	  via the file /proc/rtc and its behaviour is set by various ioctls on
	  /dev/rtc.

config SGI_NEWPORT_GFX
	tristate "SGI Newport Graphics support (EXPERIMENTAL)"
	depends on EXPERIMENTAL
	help
	  If you have an SGI machine and you want to compile the graphics
	  drivers, say Y here. This will include the code for the
	  /dev/graphics and /dev/gfx drivers into the kernel for supporting
	  virtualized access to your graphics hardware.

endmenu
```
